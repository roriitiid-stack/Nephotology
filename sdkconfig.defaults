## sdkconfig.defaults
```kconfig
CONFIG_IDF_TARGET="esp32s3"

# Flash size — match the actual 8MB chip so MMU maps the full image range
CONFIG_ESPTOOLPY_FLASHSIZE_8MB=y
CONFIG_ESPTOOLPY_FLASHSIZE="8MB"

# Larger app partition: arduino-esp32 + NimBLE + FastLED build is ~1.73MB and
# overflows the 1.5MB SINGLE_APP_LARGE table. Use a custom 3MB factory partition
# (partitions.csv). 8MB flash, so there's ample room.
CONFIG_PARTITION_TABLE_CUSTOM=y
CONFIG_PARTITION_TABLE_CUSTOM_FILENAME="partitions.csv"

# Arduino convention: 1kHz tick
CONFIG_FREERTOS_HZ=1000

# Don't auto-start Arduino; Nephotomentals.cpp provides its own app_main()
CONFIG_AUTOSTART_ARDUINO=n

# BLE: NimBLE host, no Bluedroid
CONFIG_BT_ENABLED=y
CONFIG_BT_NIMBLE_ENABLED=y
CONFIG_BT_BLUEDROID_ENABLED=n
CONFIG_BT_CONTROLLER_ENABLED=y

# arduino-esp32's bundled BLE library is dropped from ARDUINO_ALL_LIBRARIES
# via a patch in managed_components/espressif__arduino-esp32/CMakeLists.txt.
# (h2zero/esp-nimble-cpp is used directly instead.)

# C++ exceptions (some Arduino code paths rely on these)
CONFIG_COMPILER_CXX_EXCEPTIONS=y

# Larger main task stack (Arduino setup/loop expectations)
CONFIG_ESP_MAIN_TASK_STACK_SIZE=8192

# Heap poisoning (light): catches buffer-overrun heap corruption at free-time
# instead of letting it crash opaquely inside tlsf_malloc much later.
# Keep this on until the FastLED-vs-BLE init-order corruption is proven gone.
CONFIG_HEAP_POISONING_LIGHT=y
```
